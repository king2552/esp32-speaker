## sdkconfig.defaults
```kconfig
# USB Device Stack
CONFIG_USB_OTG_SUPPORTED=y
CONFIG_USB_DEVICE_ENABLED=y

# Use USB OTG peripheral (not JTAG)
CONFIG_ESP_CONSOLE_USB_CDC=n
CONFIG_ESP_CONSOLE_UART_DEFAULT=y

# Increase USB task stack
CONFIG_TINYUSB_TASK_STACK_SIZE=4096

# I2S
CONFIG_I2S_ENABLE_DEBUG_LOG=n

# FreeRTOS
CONFIG_FREERTOS_HZ=1000

# Log level
CONFIG_LOG_DEFAULT_LEVEL_INFO=y
```
